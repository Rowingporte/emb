## buildroot-2025.02.7/package/HCSR04/Config.in
```kconfig
config BR2_PACKAGE_HCSR04
    bool "HCSR04"
    depends on BR2_LINUX_KERNEL
    help
      Package pour le capteur HCSR04.
```

## buildroot-2025.02.7/package/arno-prime/Config.in
```kconfig
config BR2_PACKAGE_ARNO_PRIME
    bool "arno-prime"
    depends on BR2_LINUX_KERNEL
    help
      C'est Arno Prime.
```
